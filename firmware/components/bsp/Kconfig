## firmware/components/bsp/Kconfig
```kconfig
menu "Drink Butler board"

    config ADB_TARGET_EMULATOR
        bool "Build for the QEMU emulator instead of the ES3C35P"
        default n
        help
            Swaps the board's ST77922 panel, touch, audio, battery ADC and sleep for
            emulator versions (bsp_emulator.c): Espressif QEMU's virtual RGB display,
            a pointer driven over the serial console, silent audio, a fixed battery
            reading and simulated sleep. Set by sdkconfig.emulator; see EMULATOR.md.
            The real-board build never sets this and compiles the same files as before.

endmenu
```

## firmware/main/Kconfig.projbuild
```kconfig
menu "Aaron's Drink Butler"

    config ADB_HWTEST
        bool "Build the hardware test app instead of the drink app"
        default n
        help
            The phase-1b bring-up screen (colour bars, touch crosses, backlight, beep,
            sleep). Build it with sdkconfig.hwtest, see firmware/README.md.

    config ADB_DEBUG_CONSOLE
        bool "Serial debug console (tap, open, screenshot, stats)"
        depends on !ADB_HWTEST
        default y
        help
            Reads line commands from the USB serial port so the UI can be driven and
            captured from a computer (tools/device/adb_console.py). Type "help" in
            idf.py monitor for the list.

endmenu
```
